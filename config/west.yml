## config/west.yml
```yaml
manifest:
  remotes:
    - name: zmkfirmware
      url-base: https://github.com/zmkfirmware
    - name: ShiniNet
      url-base: https://github.com/ShiniNet/
    - name: caksoylar
      url-base: https://github.com/caksoylar
    - name: kot149
      url-base: https://github.com/kot149
    - name: tsts252525
      url-base: https://github.com/tsts252525
  projects:
    - name: zmk
      remote: zmkfirmware
      revision: v0.3.0
      import: app/west.yml
    # スクロール方向反転オプションを追加したフォーク（ピンチには影響しない）。
    # 本家: ShiniNet/zmk-driver-iqs9151
    - name: zmk-driver-iqs9151
      remote: tsts252525
      revision: main
    - name: zmk-easy-charge-indicator
      remote: ShiniNet
      revision: main
    - name: zmk-rgbled-widget
      remote: caksoylar
      revision: v0.3
    - name: zmk-layout-shift
      remote: kot149
      revision: v1
    - name: zmk-scroll-snap
      remote: kot149
      revision: v1
  self:
    path: config
```
